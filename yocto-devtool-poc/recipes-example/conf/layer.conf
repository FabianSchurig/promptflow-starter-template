## yocto-devtool-poc/recipes-example/conf/layer.conf
```bitbake
# Layer configuration for yocto-devtool-poc
BBPATH .= ":${LAYERDIR}"

BBFILES += "${LAYERDIR}/recipes-*/*/*.bb \
            ${LAYERDIR}/recipes-*/*/*.bbappend"

BBFILE_COLLECTIONS += "yocto-devtool-poc"
BBFILE_PATTERN_yocto-devtool-poc = "^${LAYERDIR}/"
BBFILE_PRIORITY_yocto-devtool-poc = "6"

LAYERDEPENDS_yocto-devtool-poc = "core"
LAYERSERIES_COMPAT_yocto-devtool-poc = "kirkstone langdale mickledore nanbield scarthgap"
```
